## firmware/components/ble_central/Kconfig
```kconfig
menu "HubBLE BLE central"
    config HUBBLE_BLE_CONN_ITVL_UNITS
        int "Requested connection interval (1.25 ms units)"
        default 6
        range 6 80
        help
            6 = 7.5 ms, the target of CLAUDE.md §1.1 (added latency <= 15 ms). The peripheral may refuse; the
            negotiated value is exposed per device.

    config HUBBLE_BLE_CONN_LATENCY
        int "Requested peripheral latency (connection events) while the host is active"
        default 0
        range 0 30

    config HUBBLE_BLE_SUPERVISION_TIMEOUT_10MS
        int "Supervision timeout (10 ms units)"
        default 200
        range 100 3200
        help
            200 = 2 s (CLAUDE.md §3.3).
endmenu
```

## firmware/components/board/Kconfig
```kconfig
menu "HubBLE board"

    choice HUBBLE_BOARD
        prompt "Target board"
        default HUBBLE_BOARD_S3_ZERO
        help
            Selects the hardware variant. Board-specific values (LED, button,
            flash size) are derived below and exposed only through the
            `board` component, so no GPIO number appears anywhere else.

        config HUBBLE_BOARD_S3_ZERO
            bool "ESP32-S3-Zero style (ESP32-S3FH4R2, 4 MB flash)"

        config HUBBLE_BOARD_XIAO_S3
            bool "Seeed Studio XIAO ESP32-S3 (8 MB flash)"
    endchoice

    # --- Derived, non-user-visible board description --------------------------

    config HUBBLE_BOARD_ID
        string
        default "s3_zero" if HUBBLE_BOARD_S3_ZERO
        default "xiao_s3" if HUBBLE_BOARD_XIAO_S3

    config HUBBLE_BOARD_NAME
        string
        default "ESP32-S3-Zero" if HUBBLE_BOARD_S3_ZERO
        default "XIAO ESP32-S3" if HUBBLE_BOARD_XIAO_S3

    config HUBBLE_LED_IS_WS2812
        bool
        default y if HUBBLE_BOARD_S3_ZERO
        default n if HUBBLE_BOARD_XIAO_S3

    config HUBBLE_LED_GPIO
        int
        default 21 if HUBBLE_BOARD_S3_ZERO
        default 21 if HUBBLE_BOARD_XIAO_S3

    config HUBBLE_LED_ACTIVE_LOW
        bool
        default n if HUBBLE_BOARD_S3_ZERO
        default y if HUBBLE_BOARD_XIAO_S3

    config HUBBLE_BUTTON_GPIO
        int
        default 0

    config HUBBLE_FLASH_SIZE_MB
        int
        default 4 if HUBBLE_BOARD_S3_ZERO
        default 8 if HUBBLE_BOARD_XIAO_S3

endmenu
```

## firmware/components/bridge/Kconfig
```kconfig
menu "HubBLE power management"
    config HUBBLE_POWER_LOW_ITVL_UNITS
        int "Connection interval while the host is suspended (1.25 ms units)"
        default 32
        range 24 80
        help
            32 units = 40 ms. Longer intervals save more peripheral battery but wake-up input takes longer to be
            noticed (up to (1 + latency) intervals).

    config HUBBLE_POWER_LOW_LATENCY
        int "Peripheral latency while the host is suspended"
        default 10
        range 0 30
        help
            Number of connection events a peripheral may skip when it has nothing to send. The supervision
            timeout is derived automatically (power_low_profile()).

    config HUBBLE_POWER_SUSPEND_DELAY_MS
        int "Debounce before low-power mode starts (ms)"
        default 2000
        range 0 30000
        help
            The USB bus must stay suspended this long. Resuming is never delayed.
endmenu
```

## firmware/components/log_buffer/Kconfig
```kconfig
menu "HubBLE log buffer"
    config HUBBLE_LOG_BUFFER_SIZE
        int "RAM log ring buffer size (bytes)"
        default 16384
        range 2048 65536
        help
            Size of the internal-RAM ring buffer that keeps the latest log text for the
            web app (live logs and download). Lives in internal RAM, not PSRAM, because
            the logger can run while the flash cache is disabled.
endmenu
```

## firmware/components/ota/Kconfig
```kconfig
menu "HubBLE OTA"
    config HUBBLE_SELFTEST_TIMEOUT_S
        int "Self-test deadline after boot (seconds)"
        default 60
        range 10 600
        help
            A freshly installed image must pass its self-test within this time, otherwise it is
            marked invalid and the bootloader returns to the previous image (CLAUDE.md §3.8).

    config HUBBLE_SELFTEST_FORCE_FAIL
        bool "Force the self-test to fail (rollback test builds only)"
        default n
        help
            Makes the self-test always fail so the automatic rollback can be verified on hardware
            (M1 hardware gate). NEVER enable in release builds.
endmenu
```

## firmware/components/ota_online/Kconfig
```kconfig
menu "HubBLE online update"
    config HUBBLE_UPDATE_REPO
        string "GitHub repository that publishes the releases (owner/name)"
        default "wildzer0/HubBLE"
        help
            "Check for updates" reads the GitHub Releases API of this repository and downloads the
            release assets from it over HTTPS. The repository must be public.

    config HUBBLE_UPDATE_CONFIRM_TIMEOUT_S
        int "Seconds to wait for the physical confirmation of an install"
        default 30
        range 10 300
endmenu
```

## firmware/components/usb_hid/Kconfig
```kconfig
menu "HubBLE USB"
    config HUBBLE_USB_VID
        hex "USB vendor ID"
        default 0x303A
        help
            Defaults to Espressif's VID. Never use another vendor's VID (see docs/usb-ids.md).

    config HUBBLE_USB_PID
        hex "USB product ID"
        default 0x4001
        help
            Development PID. Request a dedicated one from Espressif before any public distribution
            (docs/usb-ids.md).

    config HUBBLE_USB_DEBUG_INJECT
        bool "Enable the debug 'inject test input' API (POST /api/v1/debug/input)"
        default n
        help
            Lets the web API press keys / move the mouse on the host without any BLE device, to verify the
            USB side in isolation (M2 hardware test). NEVER enable in release builds.
endmenu
```

## firmware/components/wifi_ap/Kconfig
```kconfig
menu "HubBLE Wi-Fi access point"
    config HUBBLE_AP_CHANNEL
        int "AP channel"
        default 1
        range 1 13
        help
            2.4 GHz channel of the SoftAP. The web app will make this configurable later (M5).

    config HUBBLE_WIFI_TX_POWER_DBM
        int "Wi-Fi transmit power (dBm)"
        default 10
        range 2 20
        help
            The AP is used from a phone within a few metres, so the default 20 dBm only makes the board hotter.
            10 dBm is plenty at that distance and noticeably cooler. Raise it if the phone loses the AP.

    config HUBBLE_ASSUME_BONDED
        bool "Pretend a BLE device is bonded (testing only)"
        default n
        help
            The AP stays on forever while no BLE peripheral is bonded (CLAUDE.md §3.5). BLE does not
            exist yet in M1, so the boot window / idle timeout logic is never exercised on hardware.
            Enable this for test builds to exercise it. Remove once pairing exists (M3/M4).
endmenu
```
